#include "peamk.dtsi"

/ {
  kscan0: kscan_0 {
        compatible = "zmk,kscan-gpio-matrix";

        diode-direction = "col2row";
        row-gpios
            = <&gpio0 20 (GPIO_ACTIVE_LOW | GPIO_PULL_UP)>
            , <&gpio0 22 (GPIO_ACTIVE_LOW | GPIO_PULL_UP)>
            , <&gpio0 24 (GPIO_ACTIVE_LOW | GPIO_PULL_UP)>
            , <&gpio0 9 (GPIO_ACTIVE_LOW | GPIO_PULL_UP)>
            , <&gpio0 10 (GPIO_ACTIVE_LOW | GPIO_PULL_UP)>
            , <&gpio1 13 (GPIO_ACTIVE_LOW | GPIO_PULL_UP)>
            , <&gpio1 15 (GPIO_ACTIVE_LOW | GPIO_PULL_UP)>
            ;

        col-gpios
            = <&shifter 0 GPIO_ACTIVE_LOW>
            , <&shifter 1 GPIO_ACTIVE_LOW>
            , <&shifter 2 GPIO_ACTIVE_LOW>
            , <&shifter 3 GPIO_ACTIVE_LOW>
            , <&shifter 4 GPIO_ACTIVE_LOW>
            , <&shifter 5 GPIO_ACTIVE_LOW>
            , <&shifter 6 GPIO_ACTIVE_LOW>
            ;
    };
};
