/*
 * Copyright (c) 2022 The ZMK Contributors
 *
 * SPDX-License-Identifier: MIT
 */

#include "peamk_c2r.dtsi"

&bootloader_key_right {
    status = "okay";
};

/ {

};

&default_transform {
    col-offset = <7>;
};
