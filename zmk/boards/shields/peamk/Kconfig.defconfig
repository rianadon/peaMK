## zmk/boards/shields/peamk/Kconfig.defconfig
```kconfig
# Copyright (c) 2022 The ZMK Contributors
# SPDX-License-Identifier: MIT

if SHIELD_PEAMK_LEFT

config ZMK_KEYBOARD_NAME
    default "PeaMK"

config ZMK_SPLIT_ROLE_CENTRAL
    default y

endif # SHIELD_PEAMK_LEFT

if SHIELD_PEAMK_LEFT || SHIELD_PEAMK_RIGHT

config ZMK_SPLIT
    default y

config SPI
    default y

config ZMK_RGB_UNDERGLOW
    select WS2812_STRIP
    select SPI

endif # SHIELD_PEAMK_LEFT || SHIELD_PEAMK_RIGHT
```

## zmk/boards/shields/peamk/Kconfig.shield
```kconfig
# Copyright (c) 2022 The ZMK Contributors
# SPDX-License-Identifier: MIT

config SHIELD_PEAMK_LEFT
    bool "PeaMK Left"
    default y if $(shields_list_contains,peamk_r2c_left)
    default y if $(shields_list_contains,peamk_c2r_left)

config SHIELD_PEAMK_RIGHT
    bool "PeaMK Right"
    default y if $(shields_list_contains,peamk_r2c_right)
    default y if $(shields_list_contains,peamk_c2r_right)
```

## zmk/config/west.yml
```yaml
manifest:
  remotes:
    - name: zmkfirmware
      url-base: https://github.com/zmkfirmware
    - name: rianadon
      url-base: https://github.com/rianadon
  projects:
    - name: zmk
      remote: rianadon
      revision: main
      import: app/west.yml
  self:
    path: config
    import: deps.yml
```
